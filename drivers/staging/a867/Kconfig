## drivers/staging/a867/Kconfig
```kconfig
config DVB_A867
	tristate "Avermedia A867 DVB receiver"
	depends on DVB_USB
	default m
	help
		Choose Y or M here if you have an Avermedia A867 device

		To compile this driver as a module, choose M here
```
